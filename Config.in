## Config.in
```kconfig
menu "MT62xx Custom Packages"
	source "$BR2_EXTERNAL_MT62XX_BSP_PATH/package/phonefetch/Config.in"
endmenu
```

## configs/mt62xx_defconfig
```kconfig
BR2_arm=y
BR2_arm7ejs=y
BR2_ARM_INSTRUCTIONS_THUMB=y
BR2_KERNEL_HEADERS_VERSION=y
BR2_DEFAULT_KERNEL_VERSION="4.19"
BR2_PACKAGE_HOST_LINUX_HEADERS_CUSTOM_4_19=y
BR2_UCLIBC_CONFIG="$(BR2_EXTERNAL_MT62XX_BSP_PATH)/board/mt62xx/uclibc.config"
BR2_TOOLCHAIN_BUILDROOT_CXX=y
BR2_TARGET_OPTIMIZATION="-Os"
BR2_OPTIMIZE_S=y
BR2_ENABLE_LTO=y
BR2_PACKAGE_OVERRIDE_FILE="$(BR2_EXTERNAL_MT62XX_BSP_PATH)/local.mk"
# BR2_TARGET_ENABLE_ROOT_LOGIN is not set
BR2_TARGET_GENERIC_GETTY_OPTIONS="-n -l /bin/sh"
BR2_ROOTFS_OVERLAY="$(BR2_EXTERNAL_MT62XX_BSP_PATH)/board/mt62xx/rootfs_overlay"
BR2_PACKAGE_BUSYBOX_CONFIG="$(BR2_EXTERNAL_MT62XX_BSP_PATH)/board/mt62xx/busybox.config"
# BR2_PACKAGE_IFUPDOWN_SCRIPTS is not set
BR2_TARGET_ROOTFS_CPIO=y
BR2_TARGET_ROOTFS_CPIO_GZIP=y
# BR2_TARGET_ROOTFS_TAR is not set
BR2_PACKAGE_PHONEFETCH=y
```

## package/phonefetch/Config.in
```kconfig
config BR2_PACKAGE_PHONEFETCH
	bool "phonefetch"
	help
	  System info fetch tool for MT62xx.
      
```
